## app/boards/shields/engikeeb/Kconfig.shield
```kconfig
# Copyright (c) 2021 The ZMK Contributors
# SPDX-License-Identifier: MIT

config SHIELD_ENGIKEEB
	def_bool $(shields_list_contains,engikeeb)
```
